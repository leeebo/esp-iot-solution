## components/touch/touch_button_sensor/Kconfig
```kconfig
menu "Touch Button Sensor Configuration"

    config TOUCH_BUTTON_SENSOR_DEBUG
        bool "Enable touch button sensor debug mode"
        default n
        help
            Enable touch button sensor debug mode. This will print detailed FSM
            information in CSV format (vl,ch,freq,raw,smooth,baseline,fused,etc.)
            for use with PC debugging and plotting tools.

endmenu
```
